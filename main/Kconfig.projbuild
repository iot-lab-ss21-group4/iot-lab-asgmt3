## main/Kconfig.projbuild
```kconfig
menu "Example Configuration"

    config INNER_BARRIER_PIN
        int "Inner barrier GPIO pin"
        range 0 34
        default 5
        help
            GPIO number (IOxx) of the inner barrier pin.

            Some GPIOs are used for other purposes (flash connections, etc.) and cannot be used as input.

            GPIOs 35-39 are input-only so cannot be used as outputs.

    config OUTER_BARRIER_PIN
        int "Outer barrier GPIO pin"
        range 0 34
        default 26
        help
            GPIO number (IOxx) of the outer barrier pin.

            Some GPIOs are used for other purposes (flash connections, etc.) and cannot be used as input.

            GPIOs 35-39 are input-only so cannot be used as outputs.

    config TRIGGER_PIN_IN
        int "Inner trigger GPIO pin"
        range 0 34
        default 23
        help
            GPIO number (IOxx) of the inner trigger pin. This pin is triggered by a network event
            (e.g. MQTT) and will output signals to the inner barrier pin.

            Some GPIOs are used for other purposes (flash connections, etc.) and cannot be used as input.

            GPIOs 35-39 are input-only so cannot be used as outputs.

    config TRIGGER_PIN_OUT
        int "Outer trigger GPIO pin"
        range 0 34
        default 18
        help
            GPIO number (IOxx) of the outer trigger pin. This pin is triggered by a network event
            (e.g. MQTT) and will output signals to the outer barrier pin.

            Some GPIOs are used for other purposes (flash connections, etc.) and cannot be used as input.

            GPIOs 35-39 are input-only so cannot be used as outputs.

    config ESP_WIFI_SSID
        string "Service Set Identifier of WiFi"
        help
            Service Set Identifier (SSID) of the wireless network to which the ESP should be connected.

    config ESP_WIFI_PASS
        string "Network key of the WiFi"
        help
            ESP gets access to the wireless network by providing the network key of the network.

    config ESP_WIFI_MAXIMUM_RETRY
        int "Connection retries of ESP to wireless network"
        range 0 20
        default 5
        help
            Number of connection retries of the ESP.

    config PUBLISHER
        bool "ESP will publish MQTT messages to broker"
        default "y"
        help
            This ESP publishes MQTT messages to a public broker, where subscribers can retrive them.
            Otherwise, this ESP subscribes to topics from broker to retreive MQTT messages.

    config BROKER_URI
        string "URI of the MQTT broker"
        default "mqtt://test.mosquitto.org:1883"
        help
            Full URI of the MQTT broker to subscribe for room entrance simulation data.

            See the following webpage for further formatting details:
            https://docs.espressif.com/projects/esp-idf/en/latest/esp32/api-reference/protocols/mqtt.html#uri

endmenu
```
